## layers/meta-resin-dragonboard/conf/layer.conf
```bitbake
BBPATH .= ":${LAYERDIR}"

BBFILES += "${LAYERDIR}/recipes-*/*/*.bb \
            ${LAYERDIR}/recipes-*/*/*.bbappend"

BBFILE_COLLECTIONS += "resin-dragonboard"
BBFILE_PATTERN_resin-dragonboard := "^${LAYERDIR}/"
BBFILE_PRIORITY_resin-dragonboard = "1337"
```
